## kernel_fdt.its
```
/dts-v1/;

/ {

    description = "FIT image with single Linux kernel, FDT blob";

    #address-cells = <1>;


    images {

        kernel@0 {

            description = "ARM Linux kernel";

            data = /incbin/("./zImage");

            type = "kernel";

            arch = "arm";

            os = "linux";

            compression = "none";

            load = <0x40008000>;

            entry = <0x40008000>;

            hash@1 {

                algo = "sha256";

            };

        };

 	ramdisk@0 {
                    description = "initramfs";
                    data = /incbin/("rootfs.cpio.gz");
                    type = "ramdisk";
                    arch = "arm";
                    os = "linux";
                    compression = "gzip";
            };
	

        fdt@0 {

            description = "Olimex SOM204 Devicetree blob";

            data = /incbin/("./sun7i-a20-olimex-som204-evb-emmc.dtb");

            type = "flat_dt";

            arch = "arm";

            compression = "none";

            hash@1 {

                algo = "sha256";

            };

        };

    };


    configurations {

        default = "conf@0";


        conf@0 {

            description = "Boot Linux kernel, FDT blob";

            kernel = "kernel@0";
	
	    ramdisk = "ramdisk@0";		

            fdt = "fdt@0";
	    


            signature@0 {

                algo = "sha256,rsa2048";

                key-name-hint = "dev";

                sign-images = "kernel", "fdt";

            };

        };

    };

};
```
